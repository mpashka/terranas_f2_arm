## package/libs/mali-wayland/Config.in
```kconfig
choice
	prompt "OpenGL ES window system"
	depends on PACKAGE_mali-wayland

	config MALI_OPENGLES_FBDEV
	bool "FBDEV" if !PACKAGE_weston

	config MALI_OPENGLES_WAYLAND
	bool "WAYLAND" if PACKAGE_weston
endchoice 
```

## realtek/realtek/rtk-gpio-button/Config.in
```kconfig
config RTK_PWR_BUTTON_GPIO_NUMBER
	int
	prompt "Power button gpio number"
	default 9
	depends on PACKAGE_rtk-gpio-button
```

## realtek/realtek/rtk-transcode/Config.in
```kconfig
menu "Select Transcode options"
	depends on PACKAGE_rtk-transcoding

config FFMPEG-Transcode
	bool "Enable FFMPEG Hardware Accelerator"

config Gstreamer-Transcode
	bool "Enable Gstreamer Openmax Hardware Accelerator"

endmenu
```

## realtek/realtek/u-boot64/Config.in
```kconfig
choice
	prompt "Chip version"
	depends on PACKAGE_u-boot64
	help
	  Specify the chip version

config UBoot_CHIP_A
	bool "A"

config UBoot_CHIP_B
	bool "B"

endchoice

choice
	prompt "DDR Type for the Board"
	depends on PACKAGE_u-boot64
	help
	  Define DDR3/DDR4.

config UBoot_DDR3
	bool "DDR3"

config UBoot_DDR4
	bool "DDR4"

endchoice

choice
	prompt "Number of DDR banks"
	depends on PACKAGE_u-boot64
	help
	  Specify the # of DDR Banks (1295:2, 1296:4)

config UBoot_DDR_2BANK
	bool "2 banks"

config UBoot_DDR_4BANK
	bool "4 banks"
        depends on RTK_BOARD_CHIP_1296

endchoice

choice
	prompt "DDR Frequency"
	depends on PACKAGE_u-boot64
	help
	  Specify the frequency of DDR

config UBoot_DDR_1600
	bool "1600"

config UBoot_DDR_1866
	bool "1866"

config UBoot_DDR_2133
	bool "2133"
	depends on UBoot_DDR4

endchoice

config UBoot_CHIP_TYPE
	string
	default "0001" if UBoot_CHIP_A
	default "0002" if UBoot_CHIP_B

config UBoot_DDR_TYPE
	string
	default "DDR3" if UBoot_DDR3
	default "DDR4" if UBoot_DDR4

config UBoot_DDR_BANK
	string
	default "2" if UBoot_DDR_2BANK
	default "4" if UBoot_DDR_4BANK

config UBoot_DDR_SIZE
	string
	depends on PACKAGE_u-boot64
	default "4Gb" if (RTK_BOARD_DDR_1GB && RTK_BOARD_CHIP_1295) || (RTK_BOARD_DDR_2GB && RTK_BOARD_CHIP_1296) || (RTK_BOARD_DDR_1GB && RTK_BOARD_CHIP_1296)
	default "8+4Gb" if (RTK_BOARD_DDR_3GB && RTK_BOARD_CHIP_1296)
	default "8Gb" if (RTK_BOARD_DDR_2GB && RTK_BOARD_CHIP_1295) || (RTK_BOARD_DDR_4GB && RTK_BOARD_CHIP_1296)

config UBoot_DDR_FREQ
	string
	default "1600" if UBoot_DDR_1600
	default "1866" if UBoot_DDR_1866
	default "2133" if UBoot_DDR_2133

config UBoot_BOARD
	string
	depends on PACKAGE_u-boot64
	default "RTD1295" if RTK_BOARD_CHIP_1295
	default "RTD1296" if RTK_BOARD_CHIP_1296

config PACKAGE_u-boot64_envtools
	bool "read/modify U-Boot bootloader environment"
	depends on PACKAGE_u-boot64 && RTK_BOARD_MTD_LAYOUT
	default y
	help
		This package includes tools to read and modify U-Boot bootloader environment.
```

## realtek/realtek/zulu/Config.in
```kconfig
config ZULU_32BIT_JVM
	bool
	prompt "Use 32-bit JVM"
	depends on !PACKAGE_kmod-rtd1295-64k && PACKAGE_zulu
	default y
```

## realtek/xorg/qt5-wayland/Config.in
```kconfig
choice
	prompt "qt5 plugin platforms"
	default QT5_PLATFORM_QTWAYLAND

config QT5_PLATFORM_EGLFS
	bool "eglfs platform"
	help
	  Use QT5 eglfs platform.

config QT5_PLATFORM_QTWAYLAND
	bool "QtWayland platform"
	help
	  Use QTWayland platform.

endchoice
```

## target/linux/rtd1295/Config.in
```kconfig
config RTK_BOARD_CHIP_1295
	bool
	depends on TARGET_rtd1295

config RTK_BOARD_CHIP_1296
	bool
	depends on TARGET_rtd1295

config RTK_BOARD_DDR_1GB
	bool
	depends on TARGET_rtd1295

config RTK_BOARD_DDR_2GB
	bool
	depends on TARGET_rtd1295

config RTK_BOARD_DDR_3GB
	bool
	depends on TARGET_rtd1295

config RTK_BOARD_DDR_4GB
	bool
	depends on TARGET_rtd1295

config RTK_BOARD_MTD_LAYOUT
	bool
	depends on TARGET_rtd1295
```
